/*
 * TX16S Remote UI — транспорт на залізі: AUX1 через драйвер EdgeTX.
 *
 * Ліцензія: GPLv2 (та сама, що в EdgeTX).
 *
 * Той самий байтовий потік, що в симуляторі йде в TCP (transport_simu.cpp),
 * тут їде в справжній послідовний порт на 921600 бод. Протокол і його межі не
 * змінюються — змінюється лише труба.
 *
 * ============================================================================
 * Три рішення, які тут головні. Решта файлу — подробиці.
 * ============================================================================
 *
 * 1. ⚠️ ХТО ЦЕ КРУТИТЬ: власна задача FreeRTOS, пріоритет 2.
 *
 *    У симуляторі транспорт живе в окремому потоці ОС. На пульті потоків
 *    немає, тому контекст виконання довелося вибирати, і вибір не нейтральний.
 *
 *    Що було на столі:
 *
 *    - **menusTask (пріоритет 1)** — та сама задача, у якій виконується гачок
 *      захоплення. Відпадає: її витісняє мікшер будь-коли, а перемальовка
 *      LVGL займає десятки мілісекунд поспіль. Транспорт, підвішений за
 *      малюванням, дихав би ривками рівно тоді, коли передавати треба
 *      найбільше — у русі. Гірше того: приймання вводу теж стало б заручником
 *      малювання, а це замкнене коло «клієнт натиснув -> пульт малює ->
 *      наступне натискання чекає, доки домалює».
 *
 *    - **службова задача таймерів (пріоритет 2)** — туди ходить `spacemouse`,
 *      і спокуса зробити так само велика: `timer_create()` не потребує ані
 *      стека, ані нового гачка. Відпадає, і причина конкретна: у тій самій
 *      задачі крутиться `per10ms()` (а всередині нього — `keysPollingCycle()`,
 *      тобто наш же гачок 6) і телеметрія раз на 2 мс. Один наш прохід — це до
 *      кількох мілісекунд RLE й CRC (оцінка нижче, біля POLL_PERIOD_MS). Живучи
 *      в тій задачі, ми відсували б опитування клавіш і телеметрію рівно
 *      настільки — цілим проходом, без жодного поділу часу.
 *
 *    - **власна задача, пріоритет `MENUS_TASK_PRIO + 1` = 2** — обрано.
 *      Мікшер (4) і звук (3) витісняють нас завжди, тобто ані радіоканал, ані
 *      звук ми зачепити не можемо за побудовою. Ми витісняємо menusTask (1),
 *      тобто малювання не може заморити транспорт голодом.
 *
 *      Пріоритетів у FreeRTOS тут усього п'ять (`configMAX_PRIORITIES`), і
 *      щабель 2 — єдиний, що лишається між малюванням і звуком.
 *
 *      ⚠️ Чесно про щабель 2: він **не вільний**, на ньому вже сидить та сама
 *      службова задача таймерів. Тобто службову задачу ми все одно затримуємо
 *      — але не на весь свій прохід, як було б, якби ми жили всередині неї, а
 *      максимум на такт планувальника (1 мс): рівні пріоритети діляться часом
 *      (`configUSE_TIME_SLICING` за замовчуванням увімкнено), і задача рівного
 *      пріоритету, що прокинулась, витіснення не викликає. Виграш саме в цьому
 *      послабленні, а не в його відсутності.
 *
 *    Задача створюється з гачка 3, тобто в мить, коли порт справді
 *    налаштували на наш режим. Жодного зайвого гачка це не коштує, а на
 *    пульті, де Remote UI не ввімкнено, задачі просто немає.
 *
 * 2. ⚠️ ТРАНСПОРТ НІКОГО НЕ ЧЕКАЄ.
 *
 *    Ані блокувального запису, ані очікування вільного буфера, ані циклів
 *    «поки не відправиться». `waitForTxCompleted()` у цьому файлі не
 *    викликається жодного разу — і не має.
 *
 *    Замість очікування — питання `txCompleted()` на початку передачі:
 *
 *      прямий доступ до пам'яті ще жує буфер -> цього проходу не передаємо
 *      нічого, плитки лишаються брудними й підуть наступним проходом.
 *
 *    Те саме всередині проходу: плитка, яка не влізла в залишок буфера,
 *    повертається в брудні через `captureReturnTile()`. Це та сама плавна
 *    деградація, що описана в docs/02-architecture.md: кадри рідшають, але
 *    кожен показаний кадр цілісний.
 *
 *    Причина сувора: ми на пріоритеті 2. Задача, що чекає на 921600 бод,
 *    чекала б до 45 мс на кадр — і всі ці 45 мс не працювала б menusTask.
 *
 * 3. ⚠️ БУФЕР ПЕРЕДАЧІ МУСИТЬ ЛЕЖАТИ В `.ram`, ІНАКШЕ DMA ТИХО ВИМКНЕТЬСЯ.
 *
 *    `stm32_serial_send_buffer()` бере прямий доступ до пам'яті лише тоді,
 *    коли буфер проходить `_IS_DMA_BUFFER()` і вирівняний на 4. На STM32F4 ця
 *    перевірка — це «адреса між `_sram` і `_eram`», тобто **всередині секції
 *    `.ram`**. Звичайний `.bss` її не проходить, а `.data` на цій цілі взагалі
 *    лежить у CCM, куди прямий доступ до пам'яті не дістає.
 *
 *    Не пройшли перевірку — драйвер мовчки падає на запасний шлях «по байту
 *    через чергу», а та черга при переповненні **мовчки викидає байти**
 *    (`stm32_serial_send_byte`: `if (_fifo_full(...)) return;`). Тобто кадр
 *    поїхав би обрізаним, і побачив би це лише CRC на тому боці.
 *
 *    Тому буфер оголошений з `__DMA` — це макрос самого EdgeTX
 *    (`targets/common/arm/stm32/f4/memory_sections.h`), який кладе змінну в
 *    `.ram` і вирівнює на 4. Доказ, що це справді спрацювало, — карта пам'яті,
 *    а не це речення.
 *
 * ============================================================================
 *
 * Ще дві межі, які варто мати на увазі.
 *
 * **Порожній канал.** Поки з того боку тиша, транспорт не передає нічого: ані
 * плиток, ані вітання. Над послідовним портом поняття «клієнт під'єднався» не
 * існує, а `HELLO` за специфікацією йде «при старті, при підключенні клієнта і
 * на запит» — над UART перших двох подій немає, тож лишається запит. Отже
 * першим говорить клієнт: `PING`, у відповідь `HELLO`, далі `REFRESH`.
 *
 * ⚠️ Це **наслідок** із docs/03-protocol.md, а не записане там правило. Для
 * автора моста це контракт, тому питання винесене в результат задачі 0009:
 * правило рукостискання над послідовним портом має стояти в специфікації.
 *
 * Пульт із портом у нашому режимі й порожнім роз'ємом працює точно так само,
 * як без нього.
 *
 * **Перемикання режиму порту на льоту — залишковий ризик, названий чесно.**
 * EdgeTX гасить попередній режим викликом `serialSetCallBacks(mode, nullptr,
 * port)` **після** того, як уже зробив `deinit()` драйвера. А
 * `stm32_serial_deinit()` не просто вимикає периферію: він викликає
 * `stm32_serial_free_state()`, тобто обнуляє весь стан порту разом із
 * `st->sp`. Ані `getByte()`, ані `txCompleted()`, ані `sendBuffer()` цей
 * вказівник не перевіряють.
 *
 * Тобто між `deinit()` і нашим гачком ворота `s_linkUp` **законно підняті**, а
 * `s_ctx` уже вказує на обнулений стан. Прохід, що влучив у цей проміжок,
 * відпрацює цілком проти `st->sp == nullptr`: візьме звідти сміття як адреси (на
 * STM32F429 нульова адреса аліасована на флеш, тож негайного відмовляння може й
 * не бути) і налаштує прямий доступ до пам'яті за довільними регістрами. Це не
 * «запис у вимкнений USART», це запис куди завгодно, і називати це м'якше було б
 * неправдою.
 *
 * ⚠️ Вікно — **цілий прохід**, і скоротити його перевірками воріт не можна:
 * гачок виконується в menusTask (пріоритет 1), а наша задача (2) усередині
 * проходу процесором не поступається жодного разу. Тобто menusTask фізично не
 * може витіснити прохід, і зайві перевірки посеред нього нічого не побачили б.
 * Ворота перевіряються один раз на прохід — рівно там, де це має сенс.
 *
 * Чому це прийнято, а не закрито. Проміжок відкривається лише при
 * **повторній** ініціалізації порту, тобто при зміні режиму на льоту, а
 * зробити це можна тільки з меню — на пульті з розбитим екраном його немає.
 * При старті `state->port` нульовий, тож `deinit()` не викликається взагалі.
 * Дешевий запобіжник на майбутнє, якщо екран колись з'явиться: перевіряти в
 * проході `serialGetMode(SP_AUX1) == UART_MODE_REMOTE_UI` — обидва місця, які
 * міняють режим, пишуть налаштування **до** `serialInit()`, тому транспорт
 * побачив би зміну ще до `deinit()`. Рішення відкрите до перегляду.
 */

#if defined(REMOTE_UI) && !defined(SIMU) && !defined(BOOT)

#include <atomic>

#include "baudrate.h"
#include "capture.h"
#include "dataconstants.h"   // UART_MODE_REMOTE_UI
#include "geometry.h"
#include "hal/key_driver.h"  // MAX_KEYS — розмір буфера HELLO
#include "hello.h"
#include "input.h"
#include "os/sleep.h"
#include "os/task.h"
#include "os/time.h"
#include "protocol.h"
#include "remote_ui.h"
#include "serial.h"  // SERIAL_CONF_MODE_MASK
#include "tasks.h"   // MENUS_TASK_PRIO, AUDIO_TASK_PRIO, TASK_DEFINE_STACK
#include "tile.h"

namespace remote_ui {

namespace {

// --- Числа ------------------------------------------------------------------

// Період проходу транспорту.
//
// 2 мс обрано з двох боків. Знизу: найбільший буфер передачі (4103 байти) на
// 921600 бод іде ~44.5 мс (при 8N1 на дроті десять біт на байт, а не вісім),
// тож 2 мс — це ~4% простою каналу між пачками, а не 30%, як було б із
// періодом 20 мс. Зверху: приймальна черга драйвера — 512 байтів, тобто 5.5 мс
// потоку на цій швидкості; опитувати рідше означало б ризикувати
// переповненням.
//
// ⚠️ Скільки триває сам прохід. Порожній — одиниці мікросекунд. Найдорожчий —
// одиниці **мілісекунд**, і трапляється він не в екзотиці, а на кожному
// REFRESH: однотонна плитка стискається в 31 байт разом із кадруванням, тож у
// пачку влазить близько 130 плиток, і це 130 копіювань по 2 КБ із SDRAM плюс
// побітовий CRC по всіх 4103 байтах. Ці кілька мілісекунд ніхто не читає
// приймальну чергу — запасу в 5.5 мс вистачає, але він не безмежний. Клієнт
// шле близько 80 байтів на секунду, тобто в нормі черга майже порожня.
constexpr uint32_t POLL_PERIOD_MS = 2;

// Період, коли порт узагалі не наш (режим перемкнули). Прокидатись часто нема
// навіщо, але задача лишається живою: режим можуть повернути.
constexpr uint32_t IDLE_PERIOD_MS = 20;

// Скид декодувальника за тишею в каналі. Шар кадрування часу не має
// (docs/03-protocol.md), тому обірваний посеред кадру потік розсинхронізував би
// приймач назавжди — доки транспорт не скине його сам.
//
// Те саме число, що в transport_simu.cpp і в tools/remote_ui_proto.py: воно
// про протокол, а не про трубу.
constexpr uint32_t SILENCE_RESET_MS = 100;

// Скільки мовчання означає «клієнта більше немає».
//
// Клієнт зобов'язаний слати повний стан вводу раз на 250 мс і PING раз на 2 с,
// тому 3 с тиші — це вже не пауза. Після цього ми перестаємо передавати: на
// столі це виглядає як «висмикнули міст — пульт затих», а не як задача, що
// вічно жене плитки в нікуди.
//
// Ввід це відпустити не встигає й не мусить: за нього відповідає власний
// тайм-аут читача (1000 мс, input.h), і він спрацює раніше.
constexpr uint32_t CLIENT_TIMEOUT_MS = 3000;

// ⚠️ Скільки проходів чекати після того, як `txCompleted()` став ствердним,
// перш ніж писати новий дільник швидкості.
//
// Причина конкретна й дорога. `stm32_usart_tx_completed()`
// (`stm32_usart_driver.cpp`) повертає `LL_USART_IsActiveFlag_TXE` — «регістр
// даних вільний», а **не** «дріт замовк». Останній байт у цю мить ще їде в
// зсувному регістрі: 10.9 мкс на 921600. Запис дільника саме тоді дожував би
// його на новій швидкості — тобто зіпсував би останній байт підтвердження,
// того самого, від якого залежить усе перемикання. Прапорця TC драйвер
// назовні не віддає взагалі.
//
// Один прохід — це 2 мс, тобто 184 символьні часи на найповільнішій швидкості
// переліку. Чекати нічого не доводиться: воно вже минуло. Правило «транспорт
// нікого не чекає» лишається цілим — `waitForTxCompleted()` тут так само не
// викликається.
constexpr uint32_t BAUD_TX_DRAIN_PASSES = 1;

// Стек задачі, у словах. Прохід не рекурсивний і великих локальних змінних не
// має: усі буфери статичні. 512 слів (2 КБ) — це запас у кілька разів.
constexpr unsigned TASK_STACK_WORDS = 512;

// Пріоритет: рівно на щабель вище за menusTask.
constexpr unsigned TASK_PRIO = MENUS_TASK_PRIO + 1;

// Головна умова вибору контексту, записана так, щоб її не можна було мовчки
// порушити при перебазуванні на новий EdgeTX.
static_assert(TASK_PRIO > MENUS_TASK_PRIO,
              "транспорт має витісняти малювання, інакше кадри йтимуть ривками");
// Обидві перевірки тримаються на гілці `FREE_RTOS` у `tasks.h`: у другій гілці
// `AUDIO_TASK_PRIO` дорівнює 2 і ця перевірка не пройшла б. Сьогодні це
// нешкідливо, бо друга гілка — це симулятор, а файл під `SIMU` не збирається
// взагалі. Але знати варто: якщо upstream колись зведе гілки, тут упаде збірка,
// а не поведінка на льоту.
static_assert(TASK_PRIO < AUDIO_TASK_PRIO,
              "транспорт не сміє заважати ані звуку, ані мікшеру");

// Режим порту зберігається в чотирьох бітах на порт (`SERIAL_CONF_MODE_MASK`).
// Поки їх вистачає — все гаразд; коли upstream додасть режимів понад 15, наш
// номер мовчки обрізався б до чужого, і налаштування «Remote UI» одного дня
// стало б, скажімо, «GPS».
static_assert(UART_MODE_REMOTE_UI <= SERIAL_CONF_MODE_MASK,
              "номер режиму не влазить у поле налаштувань порту");

// ⚠️ Домашня швидкість мусить бути в переліку, і саме першою.
//
// Це не охайність. Відкат завжди йде на `REMOTE_UI_BAUDRATE` (baudrate.h), і
// якби її не було в переліку, вийшло б, що пульт вертається на швидкість, якої
// сам не дозволяє попросити: людина не змогла б повернутись туди свідомо.
static_assert(BAUD_ALLOWED[0] == REMOTE_UI_BAUDRATE,
              "домашня швидкість має бути першою в переліку дозволених");

// ⚠️ Стеля переліку — не константа з голови, а PCLK1/16 **конкретної цілі**.
//
// Сам перелік перевіряється проти неї в baudrate.h, але там немає EdgeTX і
// нема звідки взяти тактову шину. Звірка живе тут, і це не педантизм:
// специфіка конкретного пульта в коді — нуль рядків (CLAUDE.md, правило 5), а
// довгострокова ціль проєкту — інші пульти на EdgeTX. На цілі з іншим PCLK1
// перелік мовчки поїхав би за межу, драйвер написав би `CR1.OVER8` при
// увімкненому USART, і фактична швидкість вийшла б удвічі не та — тобто німий
// пульт, якого ми навіть не тримали в руках.
//
// Тут має падати збірка, а не приймач.
static_assert(BAUD_CEILING == PERI1_FREQUENCY / 16,
              "стеля переліку розійшлася з тактовою шиною цілі");

// --- Пам'ять ----------------------------------------------------------------

// ⚠️ Буфер передачі. `__DMA` тут обов'язковий — без нього прямий доступ до
// пам'яті мовчки вимкнеться (пояснення на початку файлу).
//
// Розмір — найбільший кадр протоколу. Так гарантовано, що **будь-який**
// окремий пакет улізе цілком: недоставного пакета в нас бути не може за
// побудовою. Заразом це природна пачка: 4103 байти на 921600 бод — це ~44.5 мс,
// тобто приблизно один кадр перемальовки.
uint8_t s_txBuf[MAX_FRAME_SIZE] __DMA;

// Скільки байтів у буфері вже готово, але ще не віддано драйверу.
//
// Живе всередині одного проходу: `transmit()` обнуляє його першим ділом, тож
// між проходами значення нікого не обходить.
//
// ⚠️ Дослівне «між проходами завжди нуль» тут колись стояло, і воно перестало
// бути правдою: крок 1 `baudSwitchStep()` віддає буфер драйверу сам і виходить
// повз хвостовий `sendBuffer()`, лишаючи тут довжину підтвердження. Шкоди з
// цього немає, але покладатись на нуль ззовні `transmit()` більше не можна.
size_t s_txUsed;

uint8_t s_payload[MAX_PAYLOAD_SIZE];
uint16_t s_tilePixels[TILE_MAX_PIXELS];

// Розмір рахується з MAX_KEYS, а не береться зі стелі: коли upstream додасть
// клавіш, буфер виросте сам, а не почне мовчки не вміщати пакет.
uint8_t s_helloPayload[helloMaxSize(MAX_KEYS, BAUD_ALLOWED_COUNT)];

Decoder s_decoder;

// --- Стан -------------------------------------------------------------------

// Драйвер і його контекст. Пише гачок 3 (задача menusTask), читає ця задача.
// Ворота `s_linkUp` — єдине, що синхронізує ці два боки: вказівники
// публікуються **до** підняття воріт і читаються тільки після.
const etx_serial_driver_t* s_drv;
void* s_ctx;
std::atomic<bool> s_linkUp{false};

// Порт, на якому ми зараз працюємо. Потрібен, щоб відрізнити «гасять нас» від
// «гасять когось іншого»: гачок 3 викликається для **кожного** порту, чий режим
// — наш, і чужий порт не має права збивати робочий.
const etx_serial_port_t* s_port;

// Прапорець «почати сеанс наново» — виставляє гачок при приєднанні, знімає
// задача. Окремо від s_linkUp, бо режим можуть перевстановити тим самим
// драйвером, і сеанс усе одно має початися з чистого аркуша.
std::atomic<bool> s_restart{false};

task_handle_t s_task;
bool s_taskStarted;

TASK_DEFINE_STACK(s_taskStack, TASK_STACK_WORDS);

// Далі — стан сеансу. Читає й пише лише задача транспорту, тому звичайні
// змінні: атомарність тут ні до чого.

// Чи чули ми клієнта. Поки ні — не передаємо нічого (див. «Порожній канал»).
bool s_clientSeen;

uint32_t s_lastByteMs;    // для скиду декодувальника за тишею
uint32_t s_lastPacketMs;  // для «клієнта більше немає»

bool s_helloPending;  // прийшов PING — треба назватись
uint32_t s_lastFrameSent;

// REFRESH прийшов, коли тіньового кадру ще не було (`captureMarkAllDirty()`
// відмовила). Повторюємо, доки не застосується: протокол обіцяє, що REFRESH
// завершується FRAME_END, а мовчки зникнути він права не має.
bool s_refreshDeferred;

// Скільки плиток пішло від останнього FRAME_END. Нуль означає, що закривати
// нічого: клієнту нема чого показувати, і зайвий FRAME_END лише змусив би його
// перемалювати те саме.
uint32_t s_tilesSinceFrameEnd;

// --- Стан перемикання швидкості ---------------------------------------------

// На якій швидкості ми зараз.
//
// ⚠️ Початкове значення — не нуль, і це важливо. `beginSession()` порівнює цю
// змінну з домашньою, щоб вирішити, чи треба вертатись; нуль на першому старті
// означав би «ми не вдома» і давав би зайвий відкат із зайвим лічильником ще
// до того, як хтось узагалі щось перемикав.
uint32_t s_baudCurrent = REMOTE_UI_BAUDRATE;

// Швидкість, на яку перемкнемось, коли підтвердження зійде з дроту.
// Нуль — нічого не заплановано (нуля в переліку немає й бути не може).
uint32_t s_baudPending;

// Скільки проходів минуло від того, як буфер передачі звільнився. Див.
// BAUD_TX_DRAIN_PASSES: `txCompleted()` — це TXE, а не TC.
uint32_t s_baudDrainPasses;

// Вікно повернення. `s_revertArmed` окремим прапорцем, а не нулем у
// `s_revertStartMs`: годинник переповнюється раз на 49 діб, і одна мілісекунда
// з тих 49 діб має значення «нуль». Вартість чесності — один байт.
bool s_revertArmed;
uint32_t s_revertStartMs;

// Скільки разів пульт вертався сам. Насичується: це діагностика, не гроші.
//
// ⚠️ Лічильник саме **пульта** — «я не почув моста». У моста свій, окремий,
// зі своєю причиною («я не почув пульта»). Злити їх в одне число означало б
// втратити рівно ту половину діагностики, яка каже, на чиєму боці шукати.
uint16_t s_revertCount;

// Звіт `BAUD`, який чекає відправлення.
bool s_baudReportPending;
uint8_t s_baudReportVerdict;
uint8_t s_baudReportNonce;
uint32_t s_baudReportTarget;

// ⚠️ Звіт притримано до першого валідного кадру.
//
// Потрібно лише для `REVERTED`. Ми щойно повернулись додому, бо на тому кінці
// нас не почули, — і слати звіт негайно означало б вистрелити ним у канал, на
// іншому кінці якого може не бути нікого. Пакет зник би назовсім, а це саме
// той пакет, який має пояснити людині, що дослід не вдався. Тому чекаємо, поки
// співрозмовник озветься, і аж тоді розповідаємо.
bool s_baudReportHold;

// --- Дрібниці ---------------------------------------------------------------

// Той самий годинник, що читає задача пульта (input_edgetx.cpp). Два різні
// годинники дали б різницю, яка не означає нічого.
uint32_t nowMs() { return time_get_ms(); }

// Драйвер, який ми вміємо крутити.
//
// Перевірка не формальна: у VCP (`usbd_cdc.cpp`) `sendBuffer` — nullptr,
// `getByte` — nullptr, а `usbSerialPutc()` при переповненні свого кільця
// **мовчки затирає** те, що там лежало. Тобто на VCP цей код видавав би
// зіпсовані кадри. Краще не робити нічого, ніж робити це.
bool driverUsable(const etx_serial_driver_t* drv)
{
  return drv != nullptr && drv->sendBuffer != nullptr &&
         drv->txCompleted != nullptr && drv->getByte != nullptr;
}

// ⚠️ Порт, який ми вміємо крутити. Ця перевірка потрібна саме тому, що
// існує гачок 4, а не попри нього.
//
// `isSerialModeAvailable()` — фільтр **меню**, і викликає його тільки меню.
// `initSerialPorts()` бере режим прямо з `g_eeGeneral.serialPort`, тобто з
// `radio.yml`, без жодної перевірки. А головне обмеження цього проєкту в тому,
// що `radio.yml` тут правлять **наосліп**: рядок `mode: REMOTE_UI` під `AUX2`
// доїхав би сюди без перешкод.
//
// Чим це погано конкретно: AUX1 і AUX2 користуються тим самим
// `STM32SerialDriver`, тож `driverUsable()` пропустив би обидва. Але в AUX2
// `.txDMA = nullptr` (`boards/generic_stm32/aux_ports.cpp`), і
// `stm32_serial_send_buffer()` пішов би запасним шляхом «по байту через чергу
// на 512 байтів», яка при переповненні **мовчки викидає** решту. Наша пачка —
// до 4103 байтів. Клієнт бачив би суцільні помилки CRC, а полагодити через
// меню було б неможливо: екрана немає.
//
// Умова дослівно повторює гачок 4 (docs/05-hooks.md, пункт 4), і це свідоме
// дублювання: там воно ховає режим від людини, тут — від файлу. Міняти
// обидва місця треба разом, про що в документі сказано.
bool portUsable(const etx_serial_port_t* port)
{
#if defined(AUX_SERIAL_DMA_TX)
  return port != nullptr && port == serialGetPort(SP_AUX1);
#else
  // На цій цілі прямого доступу до пам'яті на передачу немає ніде.
  (void)port;
  return false;
#endif
}

// --- Запобіжник повернення --------------------------------------------------
//
// ⚠️ Це найважливіші сорок рядків файлу. Пульт із розбитим екраном не має
// права оніміти від невдалого досліду: якби перемикання могло лишити канал
// німим, кожна невдала спроба коштувала б рятувального прошивання наосліп.
//
// Механізм має три входи й один вихід. Входи: команда клієнта, вікно
// повернення, тиша на не-домашній швидкості. Вихід один — `baudGoHome()`.

// Чи вміє цей драйвер міняти швидкість. Перевіряється окремо від
// `driverUsable()` навмисно: драйвер без `setBaudrate` цілком годиться, щоб
// возити протокол на сталій швидкості, і відмовлятись від нього через
// невміння, яке нам знадобиться раз на місяць, було б безглуздо.
//
// Заразом це й відповідь для другого транспорту (USB CDC, TCP симулятора), де
// поняття «швидкість» беззмістовне: там ця перевірка просто хибна, і пульт
// відповідає `NOT_APPLICABLE` замість того, щоб падати.
bool baudSwitchSupported()
{
  return s_drv != nullptr && s_drv->setBaudrate != nullptr &&
         s_drv->clearRxBuffer != nullptr;
}

// Ставить звіт `BAUD` у чергу. Сам звіт складається у фазі передачі: буфер
// може бути під прямим доступом до пам'яті, і чекати на нього ми не маємо
// права (те саме правило, що для HELLO).
void baudArmReport(uint8_t verdict, uint8_t nonce, uint32_t target, bool hold)
{
  s_baudReportVerdict = verdict;
  s_baudReportNonce = nonce;
  s_baudReportTarget = target;
  s_baudReportHold = hold;
  s_baudReportPending = true;
}

// ⚠️ Довідковий звіт не має права витіснити ще не відправлене `ACCEPTED`.
//
// Слот звіту один, і без цієї перевірки трапляється таке. У приймальній пачці
// одного проходу приходять два `BAUD_SET` поспіль: перший приймається
// (`s_baudPending` зведено, звіт = ACCEPTED), другий отримує `BUSY` — і `BUSY`
// **затирає** `ACCEPTED`. У канал їде «зайнято, нічого не сталося», а пульт
// після цього перемикається. Міст лишається вдома, бо повірив нашим же
// словам.
//
// Самолікування спрацювало б — за 500 мс пульт повернувся б, — але це рівно
// та розбіжність без жодної відмови в каналі, яку `nonce` і покликаний не
// допускати. Обіцяне в каналі й зроблене насправді мусять збігатися.
//
// Те саме в іншому одязі рятує `REVERTED`: він притриманий до першого
// валідного кадру, і без цієї перевірки наступна команда стерла б його разом
// із єдиним свідченням, що попередній дослід провалився (критерій 4.2).
//
// `ACCEPTED` — половина рукостискання; решта вердиктів лише пояснюють, чому
// нічого не сталося.
void baudArmReportInfo(uint8_t verdict, uint8_t nonce, uint32_t target,
                       bool hold)
{
  if (s_baudReportPending && s_baudReportVerdict == BAUD_ACCEPTED) {
    return;
  }
  baudArmReport(verdict, nonce, target, hold);
}

// Повернення на домашню швидкість. Єдиний вихід механізму — і найдешевша його
// частина, бо відбувається без співрозмовника.
//
// ⚠️ Саме тому пульт мовчить у вікні повернення (див. transmit()): якби він
// устиг почати нову пачку, половина її поїхала б на одній швидкості, половина
// на іншій. Мовчання робить відкат одним записом дільника — без очікування й
// без «а що там у прямому доступі до пам'яті».
//
// `countAsRevert` розрізняє дві причини опинитись тут, і це не облік заради
// обліку. Лічильник означає «я не почув моста» — і рівно так його читатиме
// людина, шукаючи, на чиєму боці біда. Переініціалізація порту (той самий
// шлях, але з `beginSession()`) — подія іншого роду: там ми йдемо додому не
// тому, що нас не почули, а тому, що залізо вже вдома й програмний стан треба
// звести з ним. Порахувати її означало б забруднити третьою причиною ту саму
// діагностику, яку критерій 4.3 просив розділити на дві.
//
// ⚠️ Три скиди на початку стоять **до** раннього виходу навмисно. Якби вони
// були після, повторна команда на домашню швидкість лишила б `s_revertArmed`
// піднятим назавжди — а це вічна німота, тобто рівно те, від чого весь цей
// файл і написаний.
//
// Повертає true, якщо ми справді кудись поверталися.
bool baudGoHome(bool countAsRevert)
{
  s_baudPending = 0;
  s_baudDrainPasses = 0;
  s_revertArmed = false;

  if (s_baudCurrent == REMOTE_UI_BAUDRATE) {
    return false;
  }

  if (baudSwitchSupported()) {
    s_drv->setBaudrate(s_ctx, REMOTE_UI_BAUDRATE);

    // ⚠️ Порядок саме такий: спершу дільник, потім очищення. Байти, що
    // ловилися в мить запису, спотворені за побудовою, і викидати їх треба
    // **після** запису, а не до нього.
    s_drv->clearRxBuffer(s_ctx);
  }

  // Обидва скиди потрібні, і жодного не досить самого по собі: перший викидає
  // байти з приймального кільця драйвера, другий — напіврозібраний кадр із
  // декодувальника. Самого пошуку маркера E7 7E тут замало: побита довжина
  // з'їдає до 4096 байтів (docs/03-protocol.md, «Точка ресинхронізації»), і
  // декодувальник осліп би рівно на ті мілісекунди, у які має щось почути.
  s_decoder.reset();

  s_baudCurrent = REMOTE_UI_BAUDRATE;
  s_lastByteMs = nowMs();

  if (countAsRevert && s_revertCount < 0xFFFF) {
    ++s_revertCount;
  }
  return true;
}

// `countAsRevert` іде наскрізь у baudGoHome(): «клієнт замовк» — це справжній
// відкат і рахується, «сеанс починається наново» — ні.
void endSession(bool countAsRevert = true)
{
  // ⚠️ Тиша на не-домашній швидкості — це теж повернення додому.
  //
  // Вікна повернення самого по собі мало: воно закриває мить перемикання, але
  // не закриває **годину потому**, коли міст перезавантажили, а пульт лишився
  // на 2 Мбод. Сюди ми потрапляємо рівно за цієї умови — «клієнта більше
  // немає», — і другого місця для цієї перевірки не потрібно.
  //
  // Зворотний бік домовленості: міст, поки він не на домашній швидкості,
  // зобов'язаний слати щонайменше один валідний кадр на секунду. PING на це
  // годиться й тайм-аут відпускання вводу не відсуває, тож сторож швидкості й
  // сторож вводу не заважають одне одному навіть теоретично.
  //
  // ⚠️ Порядок теж навмисний: додому йдемо **до** `s_clientSeen = false`.
  // Якби навпаки, став би досяжним стан «не вдома при погашеному
  // `s_clientSeen`», а вийти з нього не було б звідки — сторож живе в гілці
  // `if (s_clientSeen)`.
  baudGoHome(countAsRevert);

  // Клієнта більше немає — усе, що він тримав натиснутим, відпускається.
  // Тайм-аут читача лишається другим рубежем: він спрацює навіть тоді, коли
  // ця задача загине й сюди не дійде.
  inputState().onDisconnect();

  s_clientSeen = false;
  s_helloPending = false;
  s_refreshDeferred = false;
  s_tilesSinceFrameEnd = 0;
  s_txUsed = 0;
  s_decoder.reset();

  // Звіт про швидкість адресований тому, кого вже немає. Лічильник відкотів
  // при цьому лишається: він рахує сеанси, а не живе всередині одного.
  s_baudReportPending = false;
  s_baudReportHold = false;
}

void beginSession()
{
  // Відкотом це не рахуємо: сюди приходять при переініціалізації порту, де
  // залізо вже стоїть на домашній швидкості (наш рядок у `serialSetupPort()`),
  // і додому йде тільки програмний стан.
  endSession(false);

  const uint32_t now = nowMs();
  s_lastByteMs = now;
  s_lastPacketMs = now;

  // Лічильник кадрів беремо як є, а не «мінус один»: над послідовним портом
  // ніхто нам ще не сказав «покажи екран», і слати FRAME_END у порожнечу
  // немає сенсу. Повний екран приїде на REFRESH, як велить протокол.
  s_lastFrameSent = captureFrameCount();
}

inline bool linkUp() { return s_linkUp.load(std::memory_order_acquire); }

// --- Приймання --------------------------------------------------------------

void onPacket(uint8_t type, const uint8_t* payload, size_t length, void* context)
{
  (void)context;

  const uint32_t now = nowMs();

  // ⚠️ Вікно повернення закриває **будь-який** валідний кадр, і одного досить.
  //
  // Окремого типу «підтвердження» немає навмисно: звичайний трафік підтверджує
  // сам себе, бо клієнт зобов'язаний слати INPUT_STATE раз на 250 мс, — тобто
  // підтвердження надходить без жодної нової повинності. Хибне спрацювання
  // вимагало б, щоб сміття дало маркер E7 7E і пройшло CRC-16 (1/65536): це
  // подія раз на роки, а не раз на дослід.
  //
  // Межа названа чесно: валідний кадр доводить, що **пульт чує міст**, а не що
  // міст чує пульт. Однобічна відмова саме через швидкість фізично недосяжна —
  // і на STM32, і на ESP32 приймач із передавачем ділять один дільник, різні
  // швидкості в двох напрямках налаштувати неможливо. Однобічний обрив дроту
  // цим запобіжником не лікується і не мав би.
  s_revertArmed = false;

  // Співрозмовник озвався — притриманий звіт про відкат тепер має кому їхати.
  s_baudReportHold = false;

  // Перший валідний пакет — це і є «клієнт з'явився». Іншої ознаки над
  // послідовним портом не існує.
  if (!s_clientSeen) {
    s_clientSeen = true;
    s_lastFrameSent = captureFrameCount();
  }
  s_lastPacketMs = now;

  // ⚠️ Позначку «клієнт живий» для тайм-ауту вводу ставлять **тільки** пакети,
  // що несуть ввід, і ставить її сам розбір усередині applyInputPacket.
  // PING, REFRESH і невідомі типи його не відсувають — на етапі 2 між
  // телефоном і пультом стоїть міст ESP32, який власний посередник і цілком
  // може слати PING після того, як телефон від'єднався.
  //
  // `s_lastPacketMs` вище — інша річ: це присутність **труби**, а не вводу.
  if (applyInputPacket(inputState(), type, payload, length, now)) {
    return;
  }

  switch (type) {
    case PKT_REFRESH:
      // Кадр закриється FRAME_END сам, коли всі позначені плитки поїдуть, —
      // за правилом «карта спорожніла» у transmit(). Прапорця «прийшов REFRESH»
      // тут немає навмисно: він закривав би кадр **першою** пачкою, тобто
      // раніше за плитки, які мав закрити.
      //
      // Відмова буває одна: тіньового кадру ще немає. Тоді запит відкладається,
      // а не зникає.
      if (!captureMarkAllDirty()) {
        s_refreshDeferred = true;
      }
      break;

    case PKT_PING:
      // Відповідь складається у фазі передачі, а не тут: буфер може бути під
      // прямим доступом до пам'яті, і чекати на нього ми не маємо права.
      s_helloPending = true;
      break;

    case PKT_BAUD_SET: {
      uint32_t want = 0;
      uint8_t nonce = 0;

      // Обрізаний вантаж відкидається цілком: частково прочитане число
      // швидкості гірше за нечитане.
      if (!parseBaudSet(payload, length, want, nonce)) {
        break;
      }

      if (!baudSwitchSupported()) {
        // Транспорт без поняття швидкості. Поточну віддаємо нулем — це і є
        // «не застосовне», клієнту буде що показати замість числа.
        baudArmReportInfo(BAUD_NOT_APPLICABLE, nonce, 0, false);
        break;
      }

      // ⚠️ Одна дія за раз. Другий BAUD_SET, що прийшов, поки перший ще не
      // з'їхав на дріт, зробив би «поточну швидкість» неоднозначною: обидва
      // боки думали б, що домовились, але про різне. Це розбіжність **без
      // жодної відмови в каналі** — найгірший вид, бо ніхто її не помітить.
      //
      // Вікно повернення сюди не входить: воно щойно закрилось вище цим самим
      // пакетом, тобто перемикання вже вдалося, і нова команда законна.
      if (s_baudPending != 0) {
        baudArmReportInfo(BAUD_BUSY, nonce, s_baudCurrent, false);
        break;
      }

      if (!baudAllowed(want)) {
        baudArmReportInfo(BAUD_UNSUPPORTED, nonce, s_baudCurrent, false);
        break;
      }

      // Перемикання починається у фазі передачі: спершу підтвердження мусить
      // зійти з дроту на **старій** швидкості, і аж потім міняється дільник.
      //
      // Повторна команда на ту саму швидкість не виділяється в окремий випадок
      // навмисно: вона проходить тим самим шляхом і закінчується там само, де
      // почалась. Однаковий шлях надійніший за короткий.
      s_baudPending = want;
      baudArmReport(BAUD_ACCEPTED, nonce, want, false);
      break;
    }

    // Невідомий тип — мовчки повз, як вимагає правило сумісності. Сюди ж
    // потрапляє й пакет вводу з обрізаним вантажем: applyInputPacket відмовив,
    // а робити з ним більше нема чого.
    default:
      break;
  }
}

void receive()
{
  // Читаємо побайтово, а не через `copyRxBuffer()`, і це свідомо. Клієнт шле
  // одиниці пакетів на секунду — сотню-другу байтів, — тож виграш від пакетного
  // читання нульовий, а другий шлях у коді довелося б перевіряти на пульті,
  // якого ще ніхто не вмикав. Один шлях, який точно працює, кращий за два.
  //
  // Стеля циклу — на випадок, якщо з того боку хтось безперервно ллє байти:
  // прохід має закінчуватись завжди.
  constexpr int MAX_BYTES_PER_PASS = 1024;
  constexpr size_t CHUNK = 64;

  uint8_t chunk[CHUNK];
  size_t filled = 0;
  int total = 0;

  const auto getByte = s_drv->getByte;

  uint8_t byte;
  while (total < MAX_BYTES_PER_PASS && getByte(s_ctx, &byte) > 0) {
    chunk[filled++] = byte;
    ++total;

    if (filled == CHUNK) {
      s_decoder.feed(chunk, filled, onPacket, nullptr);
      filled = 0;
    }
  }

  if (filled > 0) {
    s_decoder.feed(chunk, filled, onPacket, nullptr);
  }

  const uint32_t now = nowMs();

  if (total > 0) {
    s_lastByteMs = now;
    return;
  }

  if (now - s_lastByteMs > SILENCE_RESET_MS) {
    // Тиша: якщо декодувальник завис посеред обірваного кадру, звільняємо
    // його. Коли він і так на початку, скид нічого не змінює.
    s_decoder.reset();
    s_lastByteMs = now;
  }
}

// --- Передача ---------------------------------------------------------------

// Дописує кадр у буфер передачі. Повертає false, якщо не влізло, — і це
// звичайний робочий результат, а не помилка.
bool appendFrame(uint8_t type, const uint8_t* payload, size_t payloadLen)
{
  const size_t frameLen = encodeFrame(type, payload, payloadLen,
                                      s_txBuf + s_txUsed,
                                      sizeof(s_txBuf) - s_txUsed);
  if (frameLen == 0) {
    return false;
  }

  s_txUsed += frameLen;
  return true;
}

// Дописує звіт `BAUD` у буфер передачі. Повертає false, якщо не влізло.
bool appendBaudReport()
{
  uint8_t payload[BAUD_REPORT_SIZE];

  // Поточну швидкість беремо тут, а не в мить постановки в чергу: підтвердження
  // йде **до** перемикання, тож у ньому має стояти стара швидкість — та, на
  // якій цей самий пакет зараз їде. Для транспорту без поняття швидкості це
  // нуль.
  const uint32_t current = baudSwitchSupported() ? s_baudCurrent : 0;

  const size_t len = buildBaudReport(payload, sizeof(payload),
                                     s_baudReportVerdict, s_baudReportNonce,
                                     s_baudReportTarget, current,
                                     BAUD_SWITCH_DELAY_MS,
                                     BAUD_REVERT_WINDOW_MS, s_revertCount);
  if (len == 0) {
    return false;
  }

  return appendFrame(PKT_BAUD, payload, len);
}

// ⚠️ Перемикання швидкості: єдине місце, де транспорт свідомо замовкає.
//
// Порядок двох боків тут головне, і першим перемикається **пульт**. Причини
// три, і всі три практичні:
//
//   1. Пульт робить це в мить, яку **сам контролює** — коли його прямий доступ
//      до пам'яті дожував пачку. Чекати чужої готовності йому нема на що.
//   2. Підтвердження — останній кадр, який пульт шле на старій швидкості.
//      Після нього в цей бік не їде нічого, тож мосту нема чого недочитувати.
//   3. Міст, отримавши підтвердження, знає точно: пульт перемкнеться не пізніше
//      ніж через `switch_delay_ms`, і число це прийшло в самому підтвердженні.
//      Тобто порядок гарантується числом, а не збігом.
//
// Зворотний варіант — «першим міст» — означав би, що пульт віддає мить
// перемикання тому боку, який якраз і не можна втратити.
//
// Повертає true, якщо цей прохід зайнятий перемиканням і робити більше нічого
// не треба.
bool baudSwitchStep()
{
  if (s_baudPending == 0) {
    return false;
  }

  // Крок 1. Підтвердження їде **саме**, без плиток: чим коротший останній кадр
  // на старій швидкості, тим менше чекати до тиші.
  if (s_baudReportPending) {
    if (appendBaudReport()) {
      s_baudReportPending = false;
      s_baudDrainPasses = 0;
      s_drv->sendBuffer(s_ctx, s_txBuf, static_cast<uint32_t>(s_txUsed));
    }
    return true;
  }

  // Крок 2. Дати останньому байтові зійти зі зсувного регістра. Сюди ми
  // потрапляємо лише з ствердним `txCompleted()` — тобто TXE вже стоїть, а от
  // дріт іще міг не замовкнути (див. BAUD_TX_DRAIN_PASSES).
  if (s_baudDrainPasses < BAUD_TX_DRAIN_PASSES) {
    ++s_baudDrainPasses;
    return true;
  }

  // Крок 3. Власне перемикання. Порядок дільник -> очищення обов'язковий:
  // байти, що ловилися в мить запису, спотворені за побудовою.
  //
  // ⚠️ Перевірка тут та сама, що в baudGoHome(), і саме тому вона є. Сьогодні
  // вона зайва: `s_baudPending` зводиться лише після ствердної відповіді, а
  // гачок пропускає тільки один драйвер на одному порту. Але дві сусідні
  // функції, з яких одна перевіряє, а друга ні, читаються як недогляд — і при
  // наступній зміні гачка 4 або `portUsable()` асиметрія перестане бути
  // нешкідливою.
  if (baudSwitchSupported()) {
    s_drv->setBaudrate(s_ctx, s_baudPending);
    s_drv->clearRxBuffer(s_ctx);
    s_decoder.reset();

    s_baudCurrent = s_baudPending;

    const uint32_t now = nowMs();
    s_revertStartMs = now;
    s_revertArmed = true;
    s_lastByteMs = now;
  }

  // Скидається в будь-якому разі: шляху, на якому `s_baudPending` лишається
  // ненульовим назавжди, бути не має — він заморозив би передачу мовчки.
  s_baudPending = 0;

  return true;
}

void transmit()
{
  // ⚠️ Єдине питання про передачу, яке ми ставимо. Ствердна відповідь означає,
  // що буфер вільний; заперечна — що цього проходу не передаємо нічого. Ніяких
  // «зачекаємо, поки звільниться».
  if (!s_drv->txCompleted(s_ctx)) {
    return;
  }

  s_txUsed = 0;

  // ⚠️ Вікно повернення відкрите — у канал не йде жоден байт.
  //
  // Це не економія трафіку, це умова дешевого відкату: почни ми пачку зараз, і
  // при поверненні половина її поїхала б на одній швидкості, половина на іншій
  // (пояснення в baudGoHome()). Плитки при цьому не зникають — вони лишаються
  // брудними в карті й поїдуть, щойно вікно закриється.
  if (s_revertArmed) {
    return;
  }

  // Перемикання попереду всього іншого: воно займає прохід цілком.
  if (baudSwitchStep()) {
    return;
  }

  // Звіт, який нікуди не веде: UNSUPPORTED, BUSY, NOT_APPLICABLE або REVERTED.
  // Він їде разом зі звичайним потоком і нічого не блокує.
  if (s_baudReportPending && !s_baudReportHold) {
    if (appendBaudReport()) {
      s_baudReportPending = false;
    }
  }

  // Вітання йде першим: інакше пачка плиток могла б відсувати його
  // проходами, а клієнт до HELLO не знає навіть розміру екрана.
  if (s_helloPending) {
    const size_t helloLen = buildHello(s_helloPayload, sizeof(s_helloPayload),
                                    baudSwitchSupported() ? s_baudCurrent : 0);
    if (helloLen > 0 && appendFrame(PKT_HELLO, s_helloPayload, helloLen)) {
      s_helloPending = false;
    }
  }

  // Відкладений REFRESH: щойно тіньовий кадр з'явився, застосовуємо його.
  if (s_refreshDeferred && captureMarkAllDirty()) {
    s_refreshDeferred = false;
  }

  // Лічильник кадрів знімається **до** порції плиток: інакше кадр, який
  // завершився вже під час відправлення, порахувався б відправленим, а
  // частина його плиток лишилася б у карті до наступної зміни екрана.
  const uint32_t framesBefore = captureFrameCount();

  // `drained` — чи карта брудних плиток спорожніла саме цим проходом. Це не
  // дрібниця обліку, а половина правила закриття кадру нижче.
  bool drained = false;

  int sentTiles = 0;
  TileRef tile;
  while (sentTiles < TILE_COUNT) {
    if (!captureTakeTile(tile, s_tilePixels, TILE_MAX_PIXELS)) {
      drained = true;
      break;
    }

    const size_t payloadLen =
        encodeTilePayload(tile, s_tilePixels, s_payload, sizeof(s_payload));

    if (payloadLen == 0) {
      // Скласти пакет не вийшло — це не розрив, а наша помилка. Плитку
      // повертаємо в брудні, інакше зміна зникне тихо.
      captureReturnTile(tile);
      break;
    }

    if (!appendFrame(PKT_TILE, s_payload, payloadLen)) {
      // Пачка заповнена. Плитка лишається брудною і піде наступним проходом —
      // це і є вся плавна деградація.
      //
      // Так, її щойно стиснули дарма. Один зайвий RLE на прохід дешевший за
      // спробу вгадати наперед, скільки байтів дасть стиснення.
      captureReturnTile(tile);
      break;
    }

    ++sentTiles;
  }

  // Цикл міг вийти й за лічильником — на цілі, де вся сітка влазить в одну
  // пачку, це рівно шлях REFRESH. Тоді карта вже порожня, але `drained` цього
  // не побачив, і кадр закрився б на прохід пізніше.
  if (!drained && captureDirtyCount() == 0) {
    drained = true;
  }

  s_tilesSinceFrameEnd += static_cast<uint32_t>(sentTiles);

  // ⚠️ Коли закривати кадр. Дві причини, і потрібна будь-яка з них — але
  // тільки якщо від минулого FRAME_END справді щось поїхало.
  //
  // 1. **Карта спорожніла.** Усе, що ми знали про зміни, лежить на дроті —
  //    картинка в клієнта цілісна. Саме ця причина закриває кадр після
  //    REFRESH і після великої перемальовки: вони не влазять у пачку 4103
  //    байти й ідуть десятком проходів.
  //
  //    Тут вузьке місце, на якому легко помилитись: прив'язати закриття до
  //    самого REFRESH означало б закрити кадр **першою** пачкою, тобто
  //    раніше, ніж поїхали плитки, які він мав закрити. Клієнт малює в
  //    позаекранний буфер і показує його лише на FRAME_END — він показав би
  //    десяту частину екрана й тримав решту непоказаною, доки LVGL сам щось
  //    не перемалює. На нерухомому головному екрані це хвилина.
  //
  // 2. **LVGL закрив кадр** (`framesBefore` зрушив). Це причина «в русі»:
  //    поки людина крутить меню, брудні плитки з'являються швидше, ніж
  //    ідуть, карта не порожніє ніколи, і без цієї гілки картинка застигла б
  //    саме тоді, коли має рухатись.
  //
  // 3. **Плиток пішло на цілий екран.** Запобіжник від однієї межі: карта може
  //    не порожніти, а LVGL — не закривати кадрів, якщо клієнт шле REFRESH
  //    частіше, ніж зливається пачка. Міст, що перепитує REFRESH на кожному
  //    тріпотінні Wi-Fi, потрапив би саме туди, і картинка застигла б назовсім.
  //    Коли на дріт поїхав цілий екран плиток, показувати вже безпечно.
  //
  // Не влізло — `s_lastFrameSent` і `s_tilesSinceFrameEnd` лишаються як були,
  // тому наступний прохід спробує знову. Окремого прапорця для цього не
  // потрібно.
  if (s_tilesSinceFrameEnd > 0 &&
      (drained || framesBefore != s_lastFrameSent ||
       s_tilesSinceFrameEnd >= static_cast<uint32_t>(TILE_COUNT))) {
    if (appendFrame(PKT_FRAME_END, nullptr, 0)) {
      s_lastFrameSent = framesBefore;
      s_tilesSinceFrameEnd = 0;
    }
  }

  if (s_txUsed > 0) {
    // Віддаємо буфер прямому доступу до пам'яті й одразу виходимо. Драйвер
    // читатиме з s_txBuf сам; наступного проходу txCompleted() скаже, чи
    // дочитав. До того часу буфер не чіпаємо.
    s_drv->sendBuffer(s_ctx, s_txBuf, static_cast<uint32_t>(s_txUsed));
  }
}

// --- Задача -----------------------------------------------------------------

void transportTask()
{
  while (true) {
    if (!s_linkUp.load(std::memory_order_acquire)) {
      sleep_ms(IDLE_PERIOD_MS);
      continue;
    }

    if (s_restart.exchange(false, std::memory_order_relaxed)) {
      beginSession();
    }

    receive();

    // ⚠️ Запобіжник повернення — щопроходу, до передачі й незалежно від того,
    // чи ми взагалі когось чули. Це та частина, без якої решти задачі не
    // існує: код, що вміє перемикати, але не вміє вертатись, у пульт не
    // заливається.
    //
    // Вікно відлічується від миті запису дільника, а не від розбору команди й
    // не від відправлення підтвердження. Міряти треба сліпий проміжок, а не
    // підготовку до нього: усе, що було до запису, їхало на робочій швидкості
    // й могло тривати скільки завгодно (пачка плиток — до 44.5 мс).
    if (s_revertArmed && nowMs() - s_revertStartMs > BAUD_REVERT_WINDOW_MS) {
      // Це і є та сама подія, яку рахує лічильник: «я не почув моста».
      if (baudGoHome(true)) {
        // Звіт притримуємо до першого валідного кадру: див. s_baudReportHold.
        // Доказом невдачі має бути слово того, хто відкотився, а не здогадка
        // моста — журнал моста може написати що завгодно, якщо пульта на тому
        // кінці вже немає.
        baudArmReportInfo(BAUD_REVERTED, 0, REMOTE_UI_BAUDRATE, true);
      }
    }

    if (s_clientSeen) {
      if (nowMs() - s_lastPacketMs > CLIENT_TIMEOUT_MS) {
        // ⚠️ Дільник не пишемо, поки прямий доступ до пам'яті ще жує буфер.
        //
        // Шлях цілком реальний: міст перезавантажився, а пульт три секунди
        // жене плитки в нікуди й майже безперервно тримає DMA зайнятим. Запис
        // BRR у цю мить виштовхнув би до 4 КБ сміття на зламаній швидкості —
        // рівно тоді, коли міст піднімається вдома. А сміття з маркером E7 7E
        // і великою LEN осліплює його сканер до 4096 байтів, тобто ми
        // ускладнювали б собі ж відновлення.
        //
        // Відкласти на прохід тут безкоштовно: тайм-аут і так 3000 мс.
        //
        // ⚠️ Цілого проходу витримки, як у кроці 3 baudSwitchStep(), тут
        // навмисно немає, і це рішення, а не недогляд. Там витримка рятує
        // останній байт **підтвердження**, від якого залежить усе перемикання.
        // Тут співрозмовника вже немає за визначенням — ми не чули його три
        // секунди, — і найгірше, що дасть різниця TXE проти TC, це зіпсований
        // хвіст однієї плитки, яку однаково нікому показувати. Платити за це
        // ще одним прапорцем стану не варто.
        if (s_drv->txCompleted(s_ctx)) {
          endSession();
        }
      } else {
        transmit();
      }
    }

    // ⚠️ Саме sleep_ms, а не sleep_until. `sleep_until()` при простроченому
    // терміні повертається негайно й не поступається процесором — прохід, що
    // затягнувся, перетворив би задачу на цикл без пауз, а ми вище за
    // menusTask. sleep_ms поступається завжди.
    sleep_ms(POLL_PERIOD_MS);
  }
}

}  // namespace

}  // namespace remote_ui

// --- Точка входу для EdgeTX -------------------------------------------------

void remoteUiSetSerialDriver(void* ctx, const etx_serial_driver_t* drv,
                             const etx_serial_port_t* port)
{
  using namespace remote_ui;

  if (ctx == nullptr) {
    // ⚠️ Від'єднання — але не обов'язково **наше**. EdgeTX викликає цей гачок
    // для кожного порту, чий режим — наш, тож рядок `mode: REMOTE_UI`, вписаний
    // наосліп під другий порт, приходив би сюди теж. Опустити ворота на такий
    // виклик означало б тихо вбити робочий AUX1 — без жодної ознаки для людини,
    // у якої немає екрана.
    //
    // Тому гасимо себе лише тоді, коли гасять саме той порт, на якому ми
    // працюємо. `port == nullptr` (шлях `serialStop()`) своїм не вважаємо: у
    // цьому дереві `serialStop()` викликається тільки для VCP, а на VCP ми не
    // працюємо ніколи.
    if (port != nullptr && port == s_port) {
      s_linkUp.store(false, std::memory_order_release);
      s_port = nullptr;
      inputState().onDisconnect();
    }
    return;
  }

  if (!driverUsable(drv) || !portUsable(port)) {
    // Наш режим спробували ввімкнути на порту або драйвері, яких ми не вміємо.
    // Воріт не чіпаємо з тієї самої причини: на правильному порту транспорт
    // може працювати законно, і одруківка в radio.yml не має його вбивати.
    return;
  }

  // Ворота опускаються **перед** записом вказівників: інакше задача могла б
  // побачити напівоновлену пару «драйвер + контекст».
  s_linkUp.store(false, std::memory_order_release);

  s_ctx = ctx;
  s_drv = drv;
  s_port = port;

  s_restart.store(true, std::memory_order_relaxed);
  s_linkUp.store(true, std::memory_order_release);

  if (!s_taskStarted) {
    task_create(&s_task, transportTask, "remoteui", s_taskStack,
                TASK_STACK_WORDS, TASK_PRIO);
    s_taskStarted = true;
  }
}

#endif  // REMOTE_UI && !SIMU && !BOOT
